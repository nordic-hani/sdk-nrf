## prj.conf
```kconfig
#
# Copyright (c) 2019 Nordic Semiconductor ASA
#
# SPDX-License-Identifier: LicenseRef-Nordic-5-Clause
#

CONFIG_LWM2M_CARRIER=y

# The library requires newlibc
CONFIG_NEWLIB_LIBC=y

# LwM2M carrier is only compiled for hard-float
CONFIG_FPU=y
CONFIG_FP_HARDABI=y

# Modem library
CONFIG_NRF_MODEM_LIB=y
CONFIG_NRF_MODEM_LIB_SYS_INIT=n

# LTE link control
CONFIG_LTE_LINK_CONTROL=y
# Disable autoconnect
CONFIG_LTE_AUTO_INIT_AND_CONNECT=n

# PDN library
CONFIG_PDN=y
CONFIG_PDN_CONTEXTS_MAX=3

# SMS library
CONFIG_SMS=y

# Download client for DFU
CONFIG_DOWNLOAD_CLIENT=y
CONFIG_DOWNLOAD_CLIENT_MAX_FILENAME_SIZE=230

# AT Monitor
CONFIG_AT_MONITOR=y
CONFIG_AT_MONITOR_HEAP_SIZE=320

# Credential management
CONFIG_MODEM_KEY_MGMT=y

# Non-volatile Storage
CONFIG_FLASH=y
CONFIG_FLASH_PAGE_LAYOUT=y
CONFIG_NVS=y
CONFIG_MPU_ALLOW_FLASH_WRITE=y
CONFIG_FLASH_MAP=y

# Heap and stacks
CONFIG_HEAP_MEM_POOL_SIZE=4096
CONFIG_SYSTEM_WORKQUEUE_STACK_SIZE=1312

# General config
CONFIG_NETWORKING=y
CONFIG_NET_NATIVE=n
CONFIG_NET_SOCKETS=y
CONFIG_NET_SOCKETS_POSIX_NAMES=y
CONFIG_NET_SOCKETS_OFFLOAD=y

# Allow the non-secure application to request reboot
CONFIG_REBOOT=y
```

## src/main.c
```c
/*
 * Copyright (c) 2019 Nordic Semiconductor ASA
 *
 * SPDX-License-Identifier: LicenseRef-Nordic-5-Clause
 */

#ifdef CONFIG_LWM2M_CARRIER
#include <lwm2m_carrier.h>
#include "carrier_certs.h"
#endif /* CONFIG_LWM2M_CARRIER */
#include <zephyr.h>
#include <modem/lte_lc.h>

#ifdef CONFIG_LWM2M_CARRIER
void nrf_modem_recoverable_error_handler(uint32_t err)
{
	printk("Modem library recoverable error: %u\n", (unsigned int)err);
}

static void lte_event_handler(const struct lte_lc_evt *const evt)
{
	/* This event handler is not in use here. */
	ARG_UNUSED(evt);
}

void print_err(const lwm2m_carrier_event_t *evt)
{
	const lwm2m_carrier_event_error_t *err = evt->data.error;

	static const char *strerr[] = {
		[LWM2M_CARRIER_ERROR_NO_ERROR] =
			"No error",
		[LWM2M_CARRIER_ERROR_BOOTSTRAP] =
			"Bootstrap error",
		[LWM2M_CARRIER_ERROR_LTE_LINK_UP_FAIL] =
			"Failed to connect to the LTE network",
		[LWM2M_CARRIER_ERROR_LTE_LINK_DOWN_FAIL] =
			"Failed to disconnect from the LTE network",
		[LWM2M_CARRIER_ERROR_FOTA_PKG] =
			"Package refused from modem",
		[LWM2M_CARRIER_ERROR_FOTA_PROTO] =
			"Protocol error",
		[LWM2M_CARRIER_ERROR_FOTA_CONN] =
			"Connection to remote server failed",
		[LWM2M_CARRIER_ERROR_FOTA_CONN_LOST] =
			"Connection to remote server lost",
		[LWM2M_CARRIER_ERROR_FOTA_FAIL] =
			"Modem firmware update failed",
		[LWM2M_CARRIER_ERROR_CONFIGURATION] =
			"Illegal object configuration detected",
		[LWM2M_CARRIER_ERROR_INIT] =
			"Initialization failure",
		[LWM2M_CARRIER_ERROR_INTERNAL] =
			"Internal failure",
	};

	__ASSERT(PART_OF_ARRAY(strerr[err->type]),
		 "Unhandled liblwm2m_carrier error");

	printk("%s, reason %d\n", strerr[err->type], err->value);
}

void print_deferred(const lwm2m_carrier_event_t *evt)
{
	const lwm2m_carrier_event_deferred_t *def = evt->data.deferred;

	static const char *strdef[] = {
		[LWM2M_CARRIER_DEFERRED_NO_REASON] =
			"No reason given",
		[LWM2M_CARRIER_DEFERRED_PDN_ACTIVATE] =
			"Failed to activate PDN",
		[LWM2M_CARRIER_DEFERRED_BOOTSTRAP_NO_ROUTE] =
			"No route to bootstrap server",
		[LWM2M_CARRIER_DEFERRED_BOOTSTRAP_CONNECT] =
			"Failed to connect to bootstrap server",
		[LWM2M_CARRIER_DEFERRED_BOOTSTRAP_SEQUENCE] =
			"Bootstrap sequence not completed",
		[LWM2M_CARRIER_DEFERRED_SERVER_NO_ROUTE] =
			"No route to server",
		[LWM2M_CARRIER_DEFERRED_SERVER_CONNECT] =
			"Failed to connect to server",
		[LWM2M_CARRIER_DEFERRED_SERVER_REGISTRATION] =
			"Server registration sequence not completed",
		[LWM2M_CARRIER_DEFERRED_SERVICE_UNAVAILABLE] =
			"Server in maintenance mode",
		[LWM2M_CARRIER_DEFERRED_SIM_MSISDN] =
			"Waiting for SIM MSISDN",
	};

	__ASSERT(PART_OF_ARRAY(strdef[def->reason]),
		 "Unhandled deferred reason");

	printk("Reason: %s, timeout: %d seconds\n", strdef[def->reason],
		def->timeout);
}

int lwm2m_carrier_event_handler(const lwm2m_carrier_event_t *event)
{
	int err = 0;

	switch (event->type) {
	case LWM2M_CARRIER_EVENT_INIT:
		printk("LWM2M_CARRIER_EVENT_INIT\n");
		err = lte_lc_init_and_connect_async(lte_event_handler);
		break;
	case LWM2M_CARRIER_EVENT_LTE_LINK_UP:
		printk("LWM2M_CARRIER_EVENT_LTE_LINK_UP\n");
		err = lte_lc_connect_async(NULL);
		break;
	case LWM2M_CARRIER_EVENT_LTE_LINK_DOWN:
		printk("LWM2M_CARRIER_EVENT_LTE_LINK_DOWN\n");
		err = lte_lc_offline();
		break;
	case LWM2M_CARRIER_EVENT_LTE_POWER_OFF:
		printk("LWM2M_CARRIER_EVENT_LTE_POWER_OFF\n");
		err = lte_lc_power_off();
		break;
	case LWM2M_CARRIER_EVENT_BOOTSTRAPPED:
		printk("LWM2M_CARRIER_EVENT_BOOTSTRAPPED\n");
		break;
	case LWM2M_CARRIER_EVENT_REGISTERED:
		printk("LWM2M_CARRIER_EVENT_REGISTERED\n");
		break;
	case LWM2M_CARRIER_EVENT_DEFERRED:
		printk("LWM2M_CARRIER_EVENT_DEFERRED\n");
		print_deferred(event);
		break;
	case LWM2M_CARRIER_EVENT_FOTA_START:
		printk("LWM2M_CARRIER_EVENT_FOTA_START\n");
		break;
	case LWM2M_CARRIER_EVENT_REBOOT:
		printk("LWM2M_CARRIER_EVENT_REBOOT\n");
		break;
	case LWM2M_CARRIER_EVENT_ERROR:
		printk("LWM2M_CARRIER_EVENT_ERROR\n");
		print_err(event);
		break;
	case LWM2M_CARRIER_EVENT_CERTS_INIT:
		err = carrier_cert_provision(event->data.certs_init);
		break;
	}

	return err;
}
#endif /* CONFIG_LWM2M_CARRIER */

void main(void)
{
	printk("LWM2M Carrier library sample.\n");
}
```

## src/carrier_certs.c
```c
/*
 * Copyright (c) 2021 Nordic Semiconductor ASA
 *
 * SPDX-License-Identifier: LicenseRef-Nordic-5-Clause
 */

#include <stdint.h>
#include <string.h>
#include <zephyr/toolchain.h>
#include <zephyr/sys/util.h>
#include <zephyr/sys/printk.h>
#include <modem/modem_key_mgmt.h>
#include "carrier_certs.h"

#ifdef CONFIG_LWM2M_CARRIER

#define ORANGE "\e[0;33m"
#define GREEN "\e[0;32m"
#define NORMAL "\e[0m"

static const char ca411[] = {
	/* VzW and Motive, AT&T */
	#include "../certs/DigiCertGlobalRootG2.pem"
};
static const char ca412[] = {
	/* AT&T Interop */
	#include "../certs/DSTRootCA-X3.pem"
};

BUILD_ASSERT(sizeof(ca411) < KB(4), "Cert is too large");
BUILD_ASSERT(sizeof(ca412) < KB(4), "Cert is too large");

static const struct {
	uint16_t tag;
	const char *data;
} certs[] = {
	{
		.tag = 411,
		.data = ca411,
	},
	{
		.tag = 412,
		.data = ca412,
	}
};

int carrier_cert_provision(void)
{
	int err;
	bool mismatch = 0;
	bool provisioned;

	for (int i = 0; i < ARRAY_SIZE(certs); i++) {
		err = modem_key_mgmt_exists(
			certs[i].tag, MODEM_KEY_MGMT_CRED_TYPE_CA_CHAIN, &provisioned);

		if (err) {
			return -1;
		}

		if (provisioned) {
			err = modem_key_mgmt_cmp(
				certs[i].tag, MODEM_KEY_MGMT_CRED_TYPE_CA_CHAIN,
				certs[i].data, strlen(certs[i].data));

			/* 0 on match, 1 otherwise; like memcmp() */
			mismatch = err;

			printk("Certificate found, tag %d: %s\n" NORMAL, certs[i].tag,
				mismatch ? ORANGE "mismatch" : GREEN "match");
		} else {
			printk("Certificate tag %d " ORANGE "not found\n" NORMAL,
				  certs[i].tag);
		}

		if (mismatch || !provisioned) {
			/* overwrite the certificate */
			err = modem_key_mgmt_write(
				certs[i].tag, MODEM_KEY_MGMT_CRED_TYPE_CA_CHAIN,
				certs[i].data, strlen(certs[i].data));
			if (err) {
				printk(ORANGE "ERROR: " NORMAL
				  "Unable to provision certificate, err: %d\n", err);
				return -1;
			}
			printk("Certificate provisioned, tag %d\n", certs[i].tag);
		}
	}
	return 0;
}

int carrier_psk_provision(void)
{
	if (CONFIG_LWM2M_CARRIER_SERVER_SEC_TAG) {
		char *p_psk = CONFIG_CARRIER_APP_PSK;
		uint8_t psk_len = strlen(p_psk);
		int err = 0;

		if (psk_len > 0) {
			err = modem_key_mgmt_write(CONFIG_LWM2M_CARRIER_SERVER_SEC_TAG,
			MODEM_KEY_MGMT_CRED_TYPE_PSK, p_psk, psk_len);
			printk("PSK provisioned, tag %d\n", CONFIG_LWM2M_CARRIER_SERVER_SEC_TAG);
		}
		if (err) {
			printk("Unable to provision PSK, tag %d\n", CONFIG_LWM2M_CARRIER_SERVER_SEC_TAG);
			return -1;
		}
	}

	return 0;
}

#endif /* CONFIG_LWM2M_CARRIER */
```

## src/carrier_certs.h
```c
/*
 * Copyright (c) 2021 Nordic Semiconductor ASA
 *
 * SPDX-License-Identifier: LicenseRef-Nordic-5-Clause
 */

#ifndef CARRIER_CERTS_H__
#define CARRIER_CERTS_H__

#ifdef CONFIG_LWM2M_CARRIER
#include <lwm2m_carrier.h>

int carrier_cert_provision(lwm2m_carrier_event_certs_init_t * const tags);
#endif /* CONFIG_LWM2M_CARRIER */

#endif /* CARRIER_CERTS_H__ */
```
