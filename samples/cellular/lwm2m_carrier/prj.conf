## CMakeLists.txt
```
#
# Copyright (c) 2019 Nordic Semiconductor
#
# SPDX-License-Identifier: LicenseRef-Nordic-5-Clause
#

cmake_minimum_required(VERSION 3.20.0)

find_package(Zephyr REQUIRED HINTS $ENV{ZEPHYR_BASE})
project(lwm2m-carrier)

# Generate hex files from pem files
set(gen_dir ${CMAKE_CURRENT_BINARY_DIR}/certs)
zephyr_include_directories(${gen_dir})
generate_inc_file_for_target(
    app
    certs/DigiCertGlobalRootCA.pem
    ${gen_dir}/DigiCertGlobalRootCA.pem.inc
    )
generate_inc_file_for_target(
    app
    certs/DigiCertGlobalRootG2.pem
    ${gen_dir}/DigiCertGlobalRootG2.pem.inc
    )
generate_inc_file_for_target(
    app
    certs/DigiCertTLSECCP384RootG5.pem
    ${gen_dir}/DigiCertTLSECCP384RootG5.pem.inc
    )
generate_inc_file_for_target(
    app
    certs/DigiCertTLSRSA4096RootG5.pem
    ${gen_dir}/DigiCertTLSRSA4096RootG5.pem.inc
    )
generate_inc_file_for_target(
    app
    certs/DigiCertTrustedRootG4.pem
    ${gen_dir}/DigiCertTrustedRootG4.pem.inc
    )

# NORDIC SDK APP START
target_sources(app PRIVATE src/main.c)
target_sources(app PRIVATE src/carrier_certs.c)
# NORDIC SDK APP END
```

## prj.conf
```kconfig
#
# Copyright (c) 2019 Nordic Semiconductor ASA
#
# SPDX-License-Identifier: LicenseRef-Nordic-5-Clause
#

CONFIG_LWM2M_CARRIER=y

# LwM2M carrier is only compiled for hard-float
CONFIG_FPU=y
CONFIG_FP_HARDABI=y

# Modem library
CONFIG_NRF_MODEM_LIB=y

# LTE link control
CONFIG_LTE_LINK_CONTROL=y

# PDN library
CONFIG_PDN=y

# SMS library
CONFIG_SMS=y

# Download client for DFU
CONFIG_DOWNLOAD_CLIENT=y
CONFIG_DOWNLOAD_CLIENT_MAX_FILENAME_SIZE=230
CONFIG_DOWNLOAD_CLIENT_BUF_SIZE=1024

# AT Monitor
CONFIG_AT_MONITOR=y
CONFIG_AT_MONITOR_HEAP_SIZE=320

# Credential management
CONFIG_MODEM_KEY_MGMT=y

# Non-volatile Storage
CONFIG_FLASH=y
CONFIG_FLASH_PAGE_LAYOUT=y
CONFIG_NVS=y
CONFIG_MPU_ALLOW_FLASH_WRITE=y

# Heap and stacks
CONFIG_HEAP_MEM_POOL_SIZE=4096
CONFIG_SYSTEM_WORKQUEUE_STACK_SIZE= 1536
CONFIG_MAIN_STACK_SIZE=1536

# General config
CONFIG_NETWORKING=y
CONFIG_NET_NATIVE=n
CONFIG_NET_SOCKETS=y
CONFIG_POSIX_API=y
CONFIG_NET_SOCKETS_OFFLOAD=y

# Allow the non-secure application to request reboot
CONFIG_REBOOT=y

# Default partition for NVS is unused
CONFIG_PM_PARTITION_SIZE_NVS_STORAGE=0

# DFU target library
CONFIG_DFU_TARGET=y
```

## src/carrier_certs.c
```c
/*
 * Copyright (c) 2021 Nordic Semiconductor ASA
 *
 * SPDX-License-Identifier: LicenseRef-Nordic-5-Clause
 */

#include <stdint.h>
#include <string.h>
#include <zephyr/toolchain.h>
#include <zephyr/sys/util.h>
#include <zephyr/sys/printk.h>
#include <modem/modem_key_mgmt.h>
#include "carrier_certs.h"

#ifdef CONFIG_LWM2M_CARRIER

#define ORANGE "\e[0;33m"
#define GREEN "\e[0;32m"
#define NORMAL "\e[0m"

static const char ca411[] = {
	/* VzW and Motive, AT&T */
	#include "DigiCertGlobalRootG2.pem.inc"
};
static const char ca412[] = {
	/* VzW and Motive, AT&T */
	#include "DigiCertGlobalRootCA.pem.inc"
};
static const char ca413[] = {
	/* VzW*/
	#include "DigiCertTLSECCP384RootG5.pem.inc"
};
static const char ca414[] = {
	/* VzW*/
	#include "DigiCertTLSRSA4096RootG5.pem.inc"
};
static const char ca415[] = {
	/* VzW*/
	#include "DigiCertTrustedRootG4.pem.inc"
};

BUILD_ASSERT(sizeof(ca411) < KB(4), "Cert is too large");
BUILD_ASSERT(sizeof(ca412) < KB(4), "Cert is too large");
BUILD_ASSERT(sizeof(ca413) < KB(4), "Cert is too large");
BUILD_ASSERT(sizeof(ca414) < KB(4), "Cert is too large");
BUILD_ASSERT(sizeof(ca415) < KB(4), "Cert is too large");

static const struct {
	uint16_t tag;
	const char *data;
	size_t len;
} certs[] = {
	{
		.tag = 411,
		.data = ca411,
		.len = sizeof(ca411),
	},
	{
		.tag = 412,
		.data = ca412,
		.len = sizeof(ca412),
	},
	{
		.tag = 413,
		.data = ca413,
		.len = sizeof(ca413),
	},
	{
		.tag = 414,
		.data = ca414,
		.len = sizeof(ca414),
	},
	{
		.tag = 415,
		.data = ca415,
		.len = sizeof(ca415),
	}
};

int carrier_cert_provision(void)
{
	int err;
	bool mismatch = 0;
	bool provisioned;

	for (int i = 0; i < ARRAY_SIZE(certs); i++) {
		err = modem_key_mgmt_exists(
			certs[i].tag, MODEM_KEY_MGMT_CRED_TYPE_CA_CHAIN, &provisioned);

		if (err) {
			return -1;
		}

		if (provisioned) {
			err = modem_key_mgmt_cmp(
				certs[i].tag, MODEM_KEY_MGMT_CRED_TYPE_CA_CHAIN,
				certs[i].data, certs[i].len);

			/* 0 on match, 1 otherwise; like memcmp() */
			mismatch = err;

			printk("Certificate found, tag %d: %s\n" NORMAL, certs[i].tag,
				mismatch ? ORANGE "mismatch" : GREEN "match");
		} else {
			printk("Certificate tag %d " ORANGE "not found\n" NORMAL,
				  certs[i].tag);
		}

		if (mismatch || !provisioned) {
			/* overwrite the certificate */
			err = modem_key_mgmt_write(
				certs[i].tag, MODEM_KEY_MGMT_CRED_TYPE_CA_CHAIN,
				certs[i].data, certs[i].len);
			if (err) {
				printk(ORANGE "ERROR: " NORMAL
				  "Unable to provision certificate, err: %d\n", err);
				return -1;
			}
			printk("Certificate provisioned, tag %d\n", certs[i].tag);
		}
	}
	return 0;
}

int carrier_psk_provision(void)
{
	if (CONFIG_LWM2M_CARRIER_SERVER_SEC_TAG) {
		char *p_psk = CONFIG_CARRIER_APP_PSK;

		if (strlen(p_psk) <= 0) {
			return 0;
		}

		uint8_t psk_len = strlen(p_psk);
		int err = 0;

		if (psk_len > 0) {
			err = modem_key_mgmt_write(CONFIG_LWM2M_CARRIER_SERVER_SEC_TAG,
			MODEM_KEY_MGMT_CRED_TYPE_PSK, p_psk, psk_len);
			printk("PSK provisioned, tag %d\n", CONFIG_LWM2M_CARRIER_SERVER_SEC_TAG);
		}
		if (err) {
			printk("Unable to provision PSK, tag %d\n",
				CONFIG_LWM2M_CARRIER_SERVER_SEC_TAG);
			return -1;
		}
	}

	return 0;
}

#endif /* CONFIG_LWM2M_CARRIER */
```
